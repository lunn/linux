## Documentation/devicetree/bindings/power/reset/restart-poweroff.yaml
```yaml
# SPDX-License-Identifier: (GPL-2.0 OR BSD-2-Clause)
%YAML 1.2
---
$id: http://devicetree.org/schemas/power/reset/restart-poweroff.yaml#
$schema: http://devicetree.org/meta-schemas/core.yaml#

title: Qnap Power Off driver binding

maintainers:
  - Andrew Lunn <andrew@lunn.ch>

description: |
  Buffalo Linkstation LS-XHL and LS-CHLv2, and other devices power off
  by restarting and letting u-boot keep hold of the machine until the
  user presses a button.

properties:
  compatible:
    const: restart-poweroff

required:
  - compatible

unevaluatedProperties: false

examples:
  - |
    restart_poweroff {
        compatible = "restart-poweroff";
    };
...
```

## Documentation/devicetree/bindings/rtc/marvell,orion-rtc.yaml
```yaml
# SPDX-License-Identifier: (GPL-2.0-only OR BSD-2-Clause)
%YAML 1.2
---
$id: http://devicetree.org/schemas/rtc/marvell,orion-rtc.yaml#
$schema: http://devicetree.org/meta-schemas/core.yaml#

title: MVEBU Orion RTC

allOf:
  - $ref: "rtc.yaml#"

maintainers:
  - Andrew Lunn <andrew@lunn.ch>

properties:
  compatible:
    oneOf:
      - enum:
          - marvell,orion-rtc
      - items:
          - enum:
              - marvell,kirkwood-rtc
          - const: marvell,orion-rtc

  reg:
    maxItems: 1

  interrupts:
    maxItems: 1

  clocks:
    maxItems: 1

required:
  - compatible
  - reg
  - interrupts

additionalProperties: false

examples:
  - |
    rtc@10300 {
        compatible = "marvell,orion-rtc";
        reg = <0xd0010300 0x20>;
        interrupts = <50>;
    };
...
```

## Documentation/devicetree/bindings/sound/marvell,kirkwood-audio.yaml
```yaml
# SPDX-License-Identifier: (GPL-2.0+ OR BSD-2-Clause)
%YAML 1.2
---
$id: http://devicetree.org/schemas/sound/marvell,kirkwood-audio.yaml#
$schema: http://devicetree.org/meta-schemas/core.yaml#

title: Marvel Kirkwood, Dove and Armada 370 Audio Interface

maintainers:
  - Andrew Lunn <andrew@lunn.ch>

properties:
  $nodename:
    pattern: "^audio-controller(@.*)?$"

  compatible:
    enum:
      - marvell,kirkwood-audio
      - marvell,dove-audio
      - marvell,armada370-audio

  reg:
    description:
      Physical address of the controller

  interrupts:
    description:
      For Dove, the first interrupt is for data, the second for errors
    minItems: 1
    maxItems: 2

  clocks:
    description:
      Internal clock, and optional external clock
    minItems: 1
    maxItems: 2

  clock-names:
    minItems: 1
    maxItems: 2

  '#sound-dai-cells':
    const: 0

required:
  - compatible
  - reg
  - interrupts
  - clocks
  - clock-names
  - '#sound-dai-cells'

additionalProperties: false

examples:
  - |
    i2s1: audio-controller@b4000 {
        compatible = "marvell,dove-audio";
        reg = <0xb4000 0x2210>;
        interrupts = <21>, <22>;
        clocks = <&gate_clk 13>;
        clock-names = "internal";
        #sound-dai-cells = <0>;

    };
...
```

## Documentation/devicetree/bindings/thermal/marvell,kirkwood-thermal.yaml
```yaml
# SPDX-License-Identifier: (GPL-2.0-only OR BSD-2-Clause)
%YAML 1.2
---
$id: http://devicetree.org/schemas/thermal/marvell,kirkwood-thermal.yaml#
$schema: http://devicetree.org/meta-schemas/core.yaml#

title: Marvell Kirkwood Thermal Controller

maintainers:
  - Andrew Lunn <andrew@lunn.ch>

properties:
  compatible:
    enum:
      - marvell,kirkwood-thermal

  reg:
    maxItems: 1

required:
  - compatible
  - reg

additionalProperties: false

examples:
  - |
    thermal@10078 {
        compatible = "marvell,kirkwood-thermal";
        reg = <0x10078 0x4>;
    };
...
```

## Documentation/devicetree/bindings/timer/marvell,orion-timer.yaml
```yaml
# SPDX-License-Identifier: GPL-2.0-only
%YAML 1.2
---
$id: http://devicetree.org/schemas/timer/marvell,orion-timer.yaml#
$schema: http://devicetree.org/meta-schemas/core.yaml#

title: Marvell Orion Timer bindings

maintainers:
  - Andrew Lunn <andrew@lunn.ch>

properties:
  $nodename:
    pattern: '^timer@[a-f0-9]+$'

  compatible:
    const: marvell,orion-timer

  reg:
    description:
      Base address of the timer register starting with TIMERS CONTROL register
    maxItems: 1

  interrupts:
    description:
      Should contain the interrupts for Timer0 and Timer1
    minItems: 2
    maxItems: 2

  clocks:
    description:
      phandle of timer reference clock (tclk)
    maxItems: 1

required:
  - compatible
  - reg
  - interrupts

additionalProperties: false

examples:
  - |
    timer: timer@20300 {
        compatible = "marvell,orion-timer";
        reg = <0x20300 0x20>;
        interrupt-parent = <&bridge_intc>;
        interrupts = <1>, <2>;
        clocks = <&core_clk 0>;
    };
...
```

## Documentation/devicetree/bindings/usb/marvell,orion-ehci.yaml
```yaml
# SPDX-License-Identifier: (GPL-2.0-only OR BSD-2-Clause)
%YAML 1.2
---
$id: http://devicetree.org/schemas/usb/marvell,orion-ehci.yaml#
$schema: http://devicetree.org/meta-schemas/core.yaml#

title: Marvell Orion USB Controller

maintainers:
  - Andrew Lunn <andrew@lunn.ch>

properties:
  compatible:
    enum:
      - marvell,orion-ehci
      - marvell,armada-3700-ehci

  reg:
    maxItems: 1

  interrupts:
    maxItems: 1

  clocks:
    maxItems: 1

  phys:
    maxItems: 1

  phy-names:
    description: Name of the USB PHY
    const: 'usb'

required:
  - compatible
  - reg
  - interrupts

additionalProperties: false

examples:
  - |
    ehci@50000 {
        compatible = "marvell,orion-ehci";
        reg = <0x50000 0x1000>;
        interrupts = <19>;
    };
...
```

## Documentation/devicetree/bindings/watchdog/marvell,orion-wdt.yaml
```yaml
# SPDX-License-Identifier: GPL-2.0
%YAML 1.2
---
$id: http://devicetree.org/schemas/watchdog/marvell,orion-wdt.yaml#
$schema: http://devicetree.org/meta-schemas/core.yaml#

title: Marvell Orion Watchdog Device Tree Bindings

allOf:
  - $ref: "watchdog.yaml#"

maintainers:
  - Andrew Lunn <andrew@lunn.ch>

properties:
  compatible:
    enum:
      - marvell,orion-wdt
      - marvell,armada-370-wdt
      - marvell,armada-xp-wdt
      - marvell,armada-375-wdt
      - marvell,armada-380-wdt

  reg:
    description:
      Normally two items, the timer control address and the rstout enable
      address. However armada-375 and 380 require and additional shared
      mask/unmask rstout address

  clocks:
    minItems: 1
    items:
      - description: L2/coherency fabric clock
      - description: Reference 25 MHz fixed-clock

  interrupts:
    maxItems: 1

  timeout-sec: true

required:
  - compatible
  - reg
  - clocks
  - interrupts

if:
  properties:
    compatible:
      contains:
        enum:
          - marvell,armada-xp-wdt
          - marvell,armada-375-wdt
          - marvell,armada-380-wdt
then:
  properties:
    clocks:
      minItems: 2
    clock-names:
      items:
        - const: nbclk
        - const: fixed

  required:
    - clock-names

else:
  properties:
    clocks:
      maxItems: 1

unevaluatedProperties: false

examples:
  - |
    watchdog@20300 {
        compatible = "marvell,orion-wdt";
        reg = <0x20300 0x28>, <0x20108 0x4>;
        interrupts = <3>;
        timeout-sec = <10>;
        clocks = <&gate_clk 7>;
    };
...
```

## drivers/net/pcs/Kconfig
```kconfig
# SPDX-License-Identifier: GPL-2.0-only
#
# PCS Layer Configuration
#

menuconfig PCS_DEVICE
	tristate "PCS device drivers"
	help
	  PCS drivers, sitting between the MAC and the PHY

if PCS_DEVICE

config PCS_XPCS
	tristate "Synopsys DesignWare XPCS controller"
	select MDIO_BUS
	help
	  This module provides helper functions for Synopsys DesignWare XPCS
	  controllers.

endif
```

## drivers/net/phy/Kconfig
```kconfig
# SPDX-License-Identifier: GPL-2.0-only
#
# PHY Layer Configuration
#

source "drivers/net/phy/mdio/Kconfig"

config PHYLINK
	tristate
	depends on NETDEVICES
	select PHYLIB
	select SWPHY
	help
	  PHYlink models the link between the PHY and MAC, allowing fixed
	  configuration links, PHYs, and Serdes links with MAC level
	  autonegotiation modes.

menuconfig PHYLIB
	tristate "PHY Device support and infrastructure"
	depends on NETDEVICES
	select MDIO_DEVICE
	select MDIO_DEVRES
	help
	  Ethernet controllers are usually attached to PHY
	  devices.  This option provides infrastructure for
	  managing PHY devices.

if PHYLIB

config SWPHY
	bool

config LED_TRIGGER_PHY
	bool "Support LED triggers for tracking link state"
	depends on LEDS_TRIGGERS
	help
	  Adds support for a set of LED trigger events per-PHY.  Link
	  state change will trigger the events, for consumption by an
	  LED class driver.  There are triggers for each link speed currently
	  supported by the PHY and also a one common "link" trigger as a
	  logical-or of all the link speed ones.
	  All these triggers are named according to the following pattern:
	      <mii bus id>:<phy>:<speed>

	  Where speed is in the form:
		<Speed in megabits>Mbps OR <Speed in gigabits>Gbps OR link
		for any speed known to the PHY.


comment "MII PHY device drivers"

config SFP
	tristate "SFP cage support"
	depends on I2C && PHYLINK
	depends on HWMON || HWMON=n
	select MDIO_I2C

config FIXED_PHY
	tristate "MDIO Bus/PHY emulation with fixed speed/link PHYs"
	depends on PHYLIB
	select SWPHY
	help
	  Adds the platform "fixed" MDIO Bus to cover the boards that use
	  PHYs that are not connected to the real MDIO bus.

	  Currently tested with mpc866ads and mpc8349e-mitx.

config MDIO_I2C
	tristate
	depends on I2C
	help
	  Support I2C based PHYs.  This provides a MDIO bus bridged
	  to I2C to allow PHYs connected in I2C mode to be accessed
	  using the existing infrastructure.

	  This is library mode.

source "drivers/net/phy/phy/Kconfig"

config XILINX_GMII2RGMII
	tristate "Xilinx GMII2RGMII converter driver"
	help
	  This driver support xilinx GMII to RGMII IP core it provides
	  the Reduced Gigabit Media Independent Interface(RGMII) between
	  Ethernet physical media devices and the Gigabit Ethernet controller.

endif # PHYLIB

source "drivers/net/phy/pcs/Kconfig"

config MICREL_KS8995MA
	tristate "Micrel KS8995MA 5-ports 10/100 managed Ethernet switch"
	depends on SPI
```

## drivers/net/phy/pcs/Kconfig
```kconfig
# SPDX-License-Identifier: GPL-2.0-only
#
# PCS driver configuration
#
# Please keep this file sorted by sting which apears in menuconfig.

menuconfig PCS_DEVICE
	tristate "PCS device drivers"
	help
	  PCS devices and driver infrastructure code.

if PCS_DEVICE

config PCS_XPCS
	tristate "Synopsys DesignWare XPCS controller"
	help
	  This module provides helper functions for Synopsys DesignWare XPCS
	  controllers.

endif
```
