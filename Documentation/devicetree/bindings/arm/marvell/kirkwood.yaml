## Documentation/devicetree/bindings/bus/marvell,kirkwood-mbus.yaml
```yaml
# SPDX-License-Identifier: GPL-2.0
%YAML 1.2
---
$id: http://devicetree.org/schemas/bus/marvell,kirkwood-mbus.yaml#
$schema: http://devicetree.org/meta-schemas/core.yaml#

title: Marvell MBus binding

maintainers:
  - Andrew Lunn <andrew@lunn.ch>

description: |
  ** MBus address decoding window specification

  The MBus children address space is comprised of two cells: the first one for
  the window ID and the second one for the offset within the window.
  In order to allow to describe valid and non-valid window entries, the
  following encoding is used:

    0xSIAA0000 0x00oooooo

  Where:

    S = 0x0 for a MBus valid window
    S = 0xf for a non-valid window (see below)

  If S = 0x0, then:

     I = 4-bit window target ID
    AA = windpw attribute

  If S = 0xf, then:

     I = don't care
     AA = 1 for internal register

  Following the above encoding, for each ranges entry for a MBus valid window
  (S = 0x0), an address decoding window is allocated. On the other side,
  entries for translation that do not correspond to valid windows (S = 0xf)
  are skipped.

  In the shown example, the translation entry in the 'ranges' property is what
  makes the MBus driver create a static decoding window for the corresponding
  given child device. Note that the binding does not require child nodes to be
  present. Of course, child nodes are needed to probe the devices.

  Since each window is identified by its target ID and attribute ID there's
  a special macro that can be use to simplify the translation entries:

  #define MBUS_ID(target,attributes) (((target) << 24) | ((attributes) << 16))

  ** About the window base address

  Remember the MBus controller allows a great deal of flexibility for choosing
  the decoding window base address. When planning the device tree layout it's
  possible to choose any address as the base address, provided of course there's
  a region large enough available, and with the required alignment.

  Yet in other words: there's nothing preventing us from setting a base address
  of 0xf0000000, or 0xd0000000 for the NOR device shown above, if such region is
  unused.

  ** Window allocation policy

  The mbus-node ranges property defines a set of mbus windows that are expected
  to be set by the operating system and that are guaranteed to be free of
  overlaps with one another or with the system memory ranges.

  Each entry in the property refers to exactly one window. If the
  operating system chooses to use a different set of mbus windows, it
  must ensure that any address translations performed from downstream
  devices are adapted accordingly.

  The operating system may insert additional mbus windows that do not
  conflict with the ones listed in the ranges, e.g. for mapping PCIe
  devices.  As a special case, the internal register window must be
  set up by the boot loader at the address listed in the ranges
  property, since access to that region is needed to set up the other
  windows.

allOf:
  - $ref: /schemas/simple-bus.yaml#

select:
  properties:
    compatible:
      contains:
        enum:
          - marvell,kirkwood-mbus
          - marvell,dove-mbus
          - marvell,armada370-mbus
          - marvell,armada375-mbus
          - marvell,armada380-mbus
          - marvell,armada390-mbus
          - marvell,armadaxp-mbus
          - marvell,orion5x-88f5281-mbus
          - marvell,orion5x-88f5182-mbus
          - marvell,orion5x-88f5181-mbus
          - marvell,orion5x-88f6183-mbus
          - marvell,mv78xx0-mbus

  required:
    - compatible

properties:
  "#address-cells":
    const: 2

  "#size-cells":
    const: 1

  ranges: true

  controller:
    $ref: /schemas/types.yaml#/definitions/phandle
    description:
      Contains a single phandle referring to the MBus controller
      node. This allows to specify the node that contains the
      registers that control the MBus, which is typically contained
      within the internal register window

  pcie-mem-aperture:
    description:
      This optional property contains the aperture for the memory region
      of the PCIe driver.  If it's defined, it must encode the base
      address and size for the address decoding windows allocated for
      the PCIe memory region.
    maxItems: 1

  pcie-io-aperture:
    description:
      Just as explained for the above property, this optional property
      contains the aperture for the I/O region of the PCIe driver.
    maxItems: 1

required:
  - compatible
  - "#address-cells"
  - "#size-cells"
  - ranges
  - controller

additionalProperties: false

patternProperties:
  "^.*@[0-9a-f]+$":
    type: object

    properties:

      "#address-cells":
        const: 1

      "#size-cells":
        const: 1


examples:
  - |
    #define MBUS_ID(target,attributes) (((target) << 24) | ((attributes) << 16))

    bus@f1000000 {
        compatible = "marvell,kirkwood-mbus", "simple-bus";
        #address-cells = <2>;
        #size-cells = <1>;
        ranges = <MBUS_ID(0xf0, 0x01) 0 0xf1000000 0x100000  /* internal-regs */
                  MBUS_ID(0x01, 0x2f) 0 0xf4000000 0x10000   /* nand flash */
                  MBUS_ID(0x03, 0x01) 0 0xf5000000 0x10000   /* crypto sram */
                 >;
        controller = <&mbusc>;
        pcie-mem-aperture = <0xe0000000 0x10000000>; /* 256 MiB memory space */
        pcie-io-aperture  = <0xf2000000 0x100000>;   /*   1 MiB    I/O space */

        crypto_sram: sram@301000000000000 {
            compatible = "marvell,orion-sram", "mmio-sram";
            reg = <MBUS_ID(0x03, 0x01) 0x0 0x800>;
            clocks = <&gate_clk 17>;
            #address-cells = <1>;
            #size-cells = <1>;
        };
    };

...
```

## Documentation/devicetree/bindings/bus/marvell,mbus-controller.yaml
```yaml
# SPDX-License-Identifier: GPL-2.0
%YAML 1.2
---
$id: http://devicetree.org/schemas/bus/marvell,mbus-controller.yaml#
$schema: http://devicetree.org/meta-schemas/core.yaml#

title: Marvell MBus Controller binding

maintainers:
  - Andrew Lunn <andrew@lunn.ch>

properties:
  compatible:
    const: marvell,mbus-controller

  reg:
    description:
      Two or three entries are expected (see the examples below) the
      first one controls the devices decoding window, the second one
      controls the SDRAM decoding window and the third controls the
      MBus bridge (only with the marvell,armada370-mbus and
      marvell,armadaxp-mbus compatible strings)
    minItems: 2
    maxItems: 3

required:
  - compatible
  - reg

additionalProperties: false

examples:
  - |
    mbusc: mbus-controller@20000 {
      compatible = "marvell,mbus-controller";
      reg = <0x20000 0x100>, <0x20180 0x20>, <0x20250 0x8>;
    };

...
```

## Documentation/devicetree/bindings/crypto/marvell,orion-crypto.yaml
```yaml
# SPDX-License-Identifier: GPL-2.0
%YAML 1.2
---
$id: http://devicetree.org/schemas/crypto/marvell,orion-crypto.yaml#
$schema: http://devicetree.org/meta-schemas/core.yaml#

title: Marvell Orion Cryptographic Engines And Security Accelerator

maintainers:
  - Andrew Lunn <andrew@lunn.ch>

properties:
  compatible:
    enum:
      - marvell,orion-crypto
      - marvell,kirkwood-crypto
      - marvell,dove-crypto

  reg:
    description:
      base physical address of the engine and length of memory mapped
      region. Can also contain an entry for the SRAM attached to the CESA,
      but this representation is deprecated and marvell,crypto-srams should
      be used instead
    minItems: 1
    maxItems: 2

  reg-names:
    description:
      Can contain an "sram" entry, but this representation is deprecated and
      marvell,crypto-srams should be used instead
    oneOf:
      - items:
          - const: regs
      - items:
          - const: regs
          - const: sram

  interrupts:
    maxItems: 1

  clocks:
    maxItems: 1

  marvell,crypto-srams:
    $ref: /schemas/types.yaml#/definitions/phandle
    description:
      phandle to crypto SRAM definitions

  marvell,crypto-sram-size:
    $ref: '/schemas/types.yaml#/definitions/uint32'
    description:
      SRAM size reserved for crypto operations, if not specified the whole
      SRAM is used (2KB)

required:
  - compatible
  - reg
  - interrupts

additionalProperties: false

examples:
  - |
    crypto@30000 {
        compatible = "marvell,orion-crypto";
        reg = <0x30000 0x10000>;
        reg-names = "regs";
        interrupts = <22>;
        marvell,crypto-srams = <&crypto_sram>;
        marvell,crypto-sram-size = <0x600>;
    };

...
```

## Documentation/devicetree/bindings/dma/marvell,orion-xor.yaml
```yaml
# SPDX-License-Identifier: GPL-2.0
%YAML 1.2
---
$id: http://devicetree.org/schemas/dma/marvell,orion-xor.yaml#
$schema: http://devicetree.org/meta-schemas/core.yaml#

title: Marvell Orios XOR Controller Device Tree Bindings

maintainers:
  - Andrew Lunn <andrew@lunn.ch>

properties:
  compatible:
    enum:
      - marvell,orion-xor
      - marvell,armada-380-xor
      - marvell,armada-3700-xor

  reg:
    description:
      Should contain registers location and length (two sets)
      the first set is the low registers, the second set the high
      registers for the XOR engine.
    minItems: 2
    maxItems: 2

  clocks:
    maxItems: 1

patternProperties:
  '^xor[0-9][0-9]$':
    type: object
    description:
      Properties per DMA channel

    properties:
      interrupts:
        maxItems: 1

      # The following are deprecated
      dmacap,memcpy:
        description:
          XOR channel is capable of memcpy operations
        type: boolean

      dmacap,memset:
        description:
          XOR channel is capable of memset operations
        type: boolean

      dmacap,xor:
        description:
          XOR channel is capable of xor operations
        type: boolean

      dmacap,interrupt:
        description:
          XOR channel is capable of generating interrupts
        type: boolean

    unevaluatedProperties: false

    required:
      - interrupts

required:
  - compatible
  - reg

additionalProperties: false

examples:
  - |
    xor@d0060900 {
        compatible = "marvell,orion-xor";
        reg = <0xd0060900 0x100
               0xd0060b00 0x100>;
        clocks = <&coreclk 0>;

        xor00 {
            interrupts = <51>;
        };
        xor01 {
            interrupts = <52>;
        };
    };

...
```

## Documentation/devicetree/bindings/gpio/lacie,netxbig-gpio-ext.yaml
```yaml
# SPDX-License-Identifier: (GPL-2.0-only OR BSD-2-Clause)
%YAML 1.2
---
$id: http://devicetree.org/schemas/gpio/lacie,netxbig-gpio-ext.yaml#
$schema: http://devicetree.org/meta-schemas/core.yaml#

title: GPIO extension bus found on some LaCie/Seagate boards

maintainers:
  - Andrew Lunn <andrew@lunn.ch>

properties:
  compatible:
    const: lacie,netxbig-gpio-ext

  addr-gpios:
    description:
      GPIOs representing the address register (LSB -> MSB).
  data-gpios:
    description:
      GPIOs representing the data register (LSB -> MSB).
  enable-gpio:
    description:
      latches the new configuration (address, data) on raising edge.
    maxItems: 1

required:
  - compatible
  - addr-gpios
  - data-gpios
  - enable-gpio

additionalProperties: false

examples:
  - |

    #include <dt-bindings/gpio/gpio.h>

    netxbig_gpio_ext: netxbig-gpio-ext {
        compatible = "lacie,netxbig-gpio-ext";

        addr-gpios = <&gpio1 15 GPIO_ACTIVE_HIGH
                      &gpio1 16 GPIO_ACTIVE_HIGH
                      &gpio1 17 GPIO_ACTIVE_HIGH>;
        data-gpios = <&gpio1 12 GPIO_ACTIVE_HIGH
                      &gpio1 13 GPIO_ACTIVE_HIGH
                      &gpio1 14 GPIO_ACTIVE_HIGH>;
        enable-gpio = <&gpio0 29 GPIO_ACTIVE_HIGH>;
    };
...
```

## Documentation/devicetree/bindings/gpio/marvell,orion-gpio.yaml
```yaml
# SPDX-License-Identifier: (GPL-2.0-only OR BSD-2-Clause)
%YAML 1.2
---
$id: http://devicetree.org/schemas/gpio/marvell,orion-gpio.yaml#
$schema: http://devicetree.org/meta-schemas/core.yaml#

title: Marvel Orion GPIO controller

maintainers:
  - Andrew Lunn <andrew@lunn.ch>

properties:
  compatible:
    description:
      marvell,orion-gpio should be used for Orion, Kirkwood, Dove,
      Discovery (except MV78200) and Armada 370. marvell,mv78200-gpio
      should be used for the Discovery MV78200.

      marvel,armadaxp-gpio should be used for all Armada XP SoCs
      (MV78230, MV78260, MV78460).

      marvell,armada-8k-gpio should be used for the Armada 7K and 8K
      SoCs (either from AP or CP), see
      Documentation/devicetree/bindings/arm/marvell/ap80x-system-controller.txt
      for specific details about the offset property.
    enum:
      - marvell,orion-gpio
      - marvell,mv78200-gpio
      - marvell,armadaxp-gpio
      - marvell,armada-8k-gpio

  reg:
    description:
      Address and length of the register set for the device. Only one
      entry is expected, except for the marvell,armadaxp-gpio
      variant for which two entries are expected, one for the general
      registers, one for the per-cpu registers. Not used for
      marvell,armada-8k-gpio.

  interrupts:
    description:
      The list of interrupts that are used for all the pins
      managed by this GPIO bank. There can be more than one interrupt
      for example 1 interrupt per 8 pins on Armada XP, which means 4
      interrupts per bank of 32 GPIOs.

  interrupt-controller: true

  "#interrupt-cells":
    description:
      Should be 2. The first cell is the GPIO number. The second cell is
      used to specify flags

        bits[3:0] trigger type and level flags
          1 = low-to-high edge triggered.
          2 = high-to-low edge triggered.
          4 = active high level-sensitive.
          8 = active low level-sensitive.

      Valid combinations are 1, 2, 3, 4, 8.
    const: 2

  gpio-controller: true

  ngpios:
    description:
      Number of available gpios in a bank.
    minimum: 1
    maximum: 32

  '#gpio-cells':
    description:
      The first cell is the pin number. The second cell is reserved for
      flags, unused at the moment.
    const: 2

  clocks:
    maxItems: 1

patternProperties:
  "^.*$":
    if:
      type: object
    then:
      properties:
        gpio-hog: true
        gpios: true
        output-high: true
        output-low: true
        line-name: true

      required:
        - gpio-hog
        - gpios

      additionalProperties: false

required:
  - compatible
  - reg
  - interrupts
  - interrupt-controller
  - '#interrupt-cells'
  - gpio-controller
  - ngpios
  - '#gpio-cells'

allOf:
  - if:
      properties:
        compatible:
          contains:
            const: marvell,armadaxp-gpio
    then:
      properties:
        reg:
          minItems: 2
          maxItems: 2
        reg-names:
          items:
            - const: gpio
            - const: pwm
    else:
      properties:
        reg:
          minItems: 1
          maxItems: 1

additionalProperties: false

examples:
  - |
    gpio0: gpio@d0018100 {
        compatible = "marvell,armadaxp-gpio";
        reg = <0xd0018100 0x40>,
              <0xd0018800 0x30>;
        ngpios = <32>;
        gpio-controller;
        #gpio-cells = <2>;
        interrupt-controller;
        #interrupt-cells = <2>;
        interrupts = <16>, <17>, <18>, <19>;
    };

    gpio1: gpio@18140 {
        compatible = "marvell,armada-370-gpio";
        reg = <0x18140 0x40>, <0x181c8 0x08>;
        reg-names = "gpio", "pwm";
        ngpios = <17>;
        gpio-controller;
        #gpio-cells = <2>;
        #pwm-cells = <2>;
        interrupt-controller;
        #interrupt-cells = <2>;
        interrupts = <87>, <88>, <89>;
        clocks = <&coreclk 0>;
    };
```
