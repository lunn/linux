## Documentation/devicetree/bindings/phy/phy-mvebu.txt
```
Armada 375 USB cluster
----------------------

Armada 375 comes with an USB2 host and device controller and an USB3
controller. The USB cluster control register allows to manage common
features of both USB controllers.

Required properties:

- compatible: "marvell,armada-375-usb-cluster"
- reg: Should contain usb cluster register location and length.
- #phy-cells : from the generic phy bindings, must be 1. Possible
values are 1 (USB2), 2 (USB3).

Example:
		usbcluster: usb-cluster@18400 {
			compatible = "marvell,armada-375-usb-cluster";
			reg = <0x18400 0x4>;
			#phy-cells = <1>
		};
```

## Documentation/devicetree/bindings/pinctrl/marvell,88f6192-pinctrl.yaml
```yaml
# SPDX-License-Identifier: GPL-2.0-only OR BSD-2-Clause
%YAML 1.2
---
$id: http://devicetree.org/schemas/pinctrl/marvell,88f6192-pinctrl.yaml#
$schema: http://devicetree.org/meta-schemas/core.yaml#

title: Marvell Kirkwood 88f6192 pin controller

maintainers:
  - Andrew Lunn <andrew@lunn.ch>

description:
  Bindings for Marvell's Kirkwood 88F6192 memory-mapped pin controller.

properties:
  compatible:
    items:
      - const: marvell,88f6192-pinctrl

  reg:
    maxItems: 1

patternProperties:
  '^pmx-.*$':
    type: object
    $ref: pinmux-node.yaml#

    properties:
      marvell,function:
        $ref: "/schemas/types.yaml#/definitions/string"
        description:
          Indicates the function to select.
        enum: [ audio, ge1, gpio, gpo, mii, mii-1, nand, pex, ptp, ptp-1, ptp-2,
                sata0, sata1, sdio, spi, sysrst, tdm, ts, twsi0, uart0, uart1 ]

      marvell,pins:
        $ref: /schemas/types.yaml#/definitions/string-array
        description:
          Array of MPP pins to be used for the given function.
        minItems: 1
        items:
          enum: [ mpp0, mpp1, mpp2, mpp3, mpp4, mpp5, mpp6, mpp7, mpp8, mpp9,
                  mpp10, mpp11, mpp12, mpp13, mpp14, mpp15, mpp16, mpp17,
                  mpp18, mpp19, mpp20, mpp21, mpp22, mpp23, mpp24, mpp25,
                  mpp26, mpp27, mpp28, mpp29, mpp30, mpp31, mpp32, mpp33,
                  mpp34, mpp35, mpp36, mpp37, mpp38, mpp39, mpp40, mpp41,
                  mpp42, mpp43, mpp44 ]

allOf:
  - $ref: "pinctrl.yaml#"

required:
  - compatible
  - reg

additionalProperties: false

examples:
  - |
    pinctrl@80020100 {
      compatible = "marvell,88f6180-pinctrl";
      reg = <0x80020100 0x20>;

      pmx_spi: pmx-spidc {
        marvell,pins = "mpp0", "mpp1", "mpp2", "mpp3";
        marvell,function = "spi";
      };

      pmx_spic_gpio: pmx-gpio-spi {
        marvell,pins = "mpp26", "mpp27";
        marvell,function = "gpio";
      };
    };
```

## Documentation/devicetree/bindings/pinctrl/marvell,88f6281-pinctrl.yaml
```yaml
# SPDX-License-Identifier: GPL-2.0-only OR BSD-2-Clause
%YAML 1.2
---
$id: http://devicetree.org/schemas/pinctrl/marvell,88f6281-pinctrl.yaml#
$schema: http://devicetree.org/meta-schemas/core.yaml#

title: Marvell Kirkwood 88f6281 pin controller

maintainers:
  - Andrew Lunn <andrew@lunn.ch>

description:
  Bindings for Marvell's Kirkwood 88F6281 memory-mapped pin controller.

properties:
  compatible:
    items:
      - const: marvell,88f6281-pinctrl

  reg:
    maxItems: 1

patternProperties:
  '^pmx-':
    type: object

    properties:
      marvell,function:
        $ref: "/schemas/types.yaml#/definitions/string"
        description:
          Indicates the function to select.
        enum: [ audio, ge1, gpio, gpo, mii, mii-1, nand, pex, ptp, ptp-1, ptp-2,
                sata0, sata1, sdio, spi, sysrst, tdm, ts, twsi0, twsi1, uart0,
                uart1 ]

      marvell,pins:
        $ref: /schemas/types.yaml#/definitions/string-array
        description:
          Array of MPP pins to be used for the given function.
        minItems: 1
        items:
          pattern: '^mpp([0-9]|[1-3][0-9]|4[0-9])$'

    required:
      - marvell,function
      - marvell,pins

  additionalProperties: false

allOf:
  - $ref: "pinctrl.yaml#"

required:
  - compatible
  - reg

additionalProperties: false

examples:
  - |
    pinctrl@80020100 {
      compatible = "marvell,88f6180-pinctrl";
      reg = <0x80020100 0x20>;

      pmx_spi: pmx-spi {
        marvell,pins = "mpp0", "mpp1", "mpp2", "mpp3";
        marvell,function = "spi";
      };

      pmx_spi_gpio: pmx-gpio-spi {
        marvell,pins = "mpp26", "mpp27";
        marvell,function = "gpio";
      };
    };
```

## Documentation/devicetree/bindings/pinctrl/marvell,98dx4122-pinctrl.yaml
```yaml
# SPDX-License-Identifier: GPL-2.0-only OR BSD-2-Clause
%YAML 1.2
---
$id: http://devicetree.org/schemas/pinctrl/marvell,98dx4122-pinctrl.yaml#
$schema: http://devicetree.org/meta-schemas/core.yaml#

title: Marvell 98dx4122 pin controller

maintainers:
  - Andrew Lunn <andrew@lunn.ch>

description:
  Bindings for Marvell's 98DX4122 memory-mapped pin controller.

properties:
  compatible:
    items:
      - const: marvell,98dx4122-pinctrl

  reg:
    maxItems: 1

patternProperties:
  '^pmx-':
    type: object

    properties:
      marvell,function:
        $ref: "/schemas/types.yaml#/definitions/string"
        description:
          Indicates the function to select.
        enum: [ gpio, gpo, nand, pex, spi, sysrst, twsi0, uart0, uart1 ]

      marvell,pins:
        $ref: /schemas/types.yaml#/definitions/string-array
        description:
          Array of MPP pins to be used for the given function.
        minItems: 1
        items:
          pattern: '^mpp([0-9]|[1-3][0-9]|4[0-4])$'

    required:
      - marvell,function
      - marvell,pins

  additionalProperties: false

allOf:
  - $ref: "pinctrl.yaml#"

required:
  - compatible
  - reg

additionalProperties: false

examples:
  - |
    pinctrl@80020100 {
      compatible = "marvell,88f6180-pinctrl";
      reg = <0x80020100 0x20>;

      pmx_spi: pmx-spidc {
        marvell,pins = "mpp0", "mpp1", "mpp2", "mpp3";
        marvell,function = "spi";
      };

      pmx_spi_gpio: pmx-gpio-spi {
        marvell,pins = "mpp26", "mpp27";
        marvell,function = "gpio";
      };
    };
```

## Documentation/devicetree/bindings/pinctrl/marvell,ac5-pinctrl.yaml
```yaml
# SPDX-License-Identifier: GPL-2.0-only OR BSD-2-Clause
%YAML 1.2
---
$id: http://devicetree.org/schemas/pinctrl/marvell,ac5-pinctrl.yaml#
$schema: http://devicetree.org/meta-schemas/core.yaml#

title: Marvell AC5 pin controller

maintainers:
  - Chris Packham <chris.packham@alliedtelesis.co.nz>

description:
  Bindings for Marvell's AC5 memory-mapped pin controller.

properties:
  compatible:
    items:
      - const: marvell,ac5-pinctrl

  reg:
    maxItems: 1

patternProperties:
  '^pmx-':
    type: object
    $ref: pinmux-node.yaml#

    properties:
      marvell,function:
        $ref: "/schemas/types.yaml#/definitions/string"
        description:
          Indicates the function to select.
        enum: [ dev_init_done, ge, gpio, i2c0, i2c1, int_out, led, nand, pcie,
                ptp, sdio, spi0, spi1, synce, tsen_int, uart0, uart1, uart2,
                uart3, uartsd, wd_int, xg ]

      marvell,pins:
        $ref: /schemas/types.yaml#/definitions/string-array
        description:
          Array of MPP pins to be used for the given function.
        minItems: 1
        items:
          pattern: '^mpp([0-9]|[1-3][0-9]|4[0-5])$'

    required:
      - marvell,function
      - marvell,pins

  additionalProperties: false

allOf:
  - $ref: "pinctrl.yaml#"

required:
  - compatible
  - reg

additionalProperties: false

examples:
  - |
    pinctrl@80020100 {
      compatible = "marvell,ac5-pinctrl";
      reg = <0x80020100 0x20>;

      pmx_i2c0_pins: pmx-i2c0 {
        marvell,pins = "mpp26", "mpp27";
        marvell,function = "i2c0";
      };

      pmx_i2c0_gpio: pmx-gpio-i2c0 {
        marvell,pins = "mpp26", "mpp27";
        marvell,function = "gpio";
      };
    };
```

## Documentation/devicetree/bindings/pinctrl/semtech,sx1501q.yaml
```yaml
# SPDX-License-Identifier: GPL-2.0-only OR BSD-2-Clause
%YAML 1.2
---
$id: http://devicetree.org/schemas/pinctrl/semtech,sx1501q.yaml#
$schema: http://devicetree.org/meta-schemas/core.yaml#

title: SEMTECH SX150x GPIO expander

maintainers:
  - Andrew Lunn <andrew@lunn.ch>

properties:
  compatible:
    enum:
      - semtech,sx1501q
      - semtech,sx1502q
      - semtech,sx1503q
      - semtech,sx1504q
      - semtech,sx1505q
      - semtech,sx1506q
      - semtech,sx1507q
      - semtech,sx1508q
      - semtech,sx1509q

  reg:
    description:
      I2C slave address of this device

  '#gpio-cells':
    const: 2
    description: |
      The first cell is the GPIO number and the second cell is used
      to specify optional parameters: bit 0: polarity (0: normal, 1:
      inverted)

  gpio-controller: true

  interrupts:
    description:
      Interrupt specifier for the controllers interrupt.
    maxItems: 1

  interrupt-controller: true

  '#interrupt-cells':
    description:
      Specifies the PIN numbers and Flags, as defined in defined in
      include/dt-bindings/interrupt-controller/irq.h
    const: 2

  semtech,probe-reset:
    type: boolean
    description:
      Will trigger a reset of the GPIO expander on probe,
      only for sx1507q, sx1508q and sx1509q

required:
  - compatible
  - reg
  - '#gpio-cells'

patternProperties:
  "^cfg-":
    $ref: pincfg-node.yaml#

    properties:
      pins:
        description:
          A list of pins to configure in certain ways, such as enabling
          debouncing
        items:
          pattern: "^gpio1?[0-9]{1,2}$"

additionalProperties: false

examples:
  - |
    i2c {
        #address-cells = <1>;
        #size-cells = <0>;

        pinctrl@20 {
            #gpio-cells = <2>;
            #interrupt-cells = <2>;
            compatible = "semtech,sx1506q";
            reg = <0x20>;
            interrupt-parent = <&gpio_1>;
            interrupts = <16 0>;

            gpio-controller;
            interrupt-controller;

            pinctrl-names = "default";
            pinctrl-0 = <&gpio1_cfg_pins>;

            gpio1_cfg_pins: cfg- {
                pins = "gpio1";
                bias-pull-up;
            };
        };
    };
...
```

## Documentation/devicetree/bindings/power/reset/qnap,power-off.yaml
```yaml
# SPDX-License-Identifier: (GPL-2.0 OR BSD-2-Clause)
%YAML 1.2
---
$id: http://devicetree.org/schemas/power/reset/qnap,power-off.yaml#
$schema: http://devicetree.org/meta-schemas/core.yaml#

title: Qnap Power Off driver

maintainers:
  - Andrew Lunn <andrew@lunn.ch>

description: |
  QNAP NAS devices have a microcontroller controlling the main power
  supply. This microcontroller is connected to UART1 of the Kirkwood
  and Orion5x SoCs. Sending the character 'A', at 19200 baud, tells
  the microcontroller to turn the power off.

  Synology NAS devices use a similar scheme, but a different baud
  rate, 9600, and a different character, '1'.

properties:
  compatible:
    enum:
      - qnap,power-off
      - synology,power-off

  reg:
    description:
      Address and length of the register set for UART1
    maxItems: 1

  clocks:
    description:
      tclk clock
    maxItems: 1

required:
  - compatible
  - reg
  - clocks

unevaluatedProperties: false

examples:
  - |
    poweroff@12100 {
        compatible = "qnap,power-off";
        reg = <0x12100 0x100>;
        clocks = <&gate_clk 7>;
    };
...
```
