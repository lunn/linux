## Documentation/devicetree/bindings/hwmon/gmt,g762.yaml
```yaml
# SPDX-License-Identifier: (GPL-2.0 OR BSD-2-Clause)
%YAML 1.2
---
$id: http://devicetree.org/schemas/hwmon/gmt,g762.yaml#
$schema: http://devicetree.org/meta-schemas/core.yaml#

title: GMT G762/G763 PWM Fan controller

maintainers:
  - Andrew Lunn <andrew@lunn.ch>

description:
  If an optional property is not set in .dts file, then
  current value is kept unmodified (e.g. u-boot installed value).

  Additional information on operational parameters for the device is
  available in Documentation/hwmon/g762.rst. A detailed datasheet for
  the device is available at
  http://natisbad.org/NAS/refs/GMT_EDS-762_763-080710-0.2.pdf.

properties:
  compatible:
    enum:
      - gmt,g762
      - gmt,g763

  reg:
    description:
      I2C bus address of the device

  clocks:
    description:
      Fixed clock providing input clock frequency on CLK pin of the chip.
    maxItems: 1

  fan_startv:
    description:
      fan startup voltage. The higher the more.
    enum: [0, 1, 2, 3]

  pwm_polarity:
    description:
      pwm polarity. Accepted values are 0 (positive duty) and
      1 (negative duty).
    enum: [0, 1]

  fan_gear_mode:
    enum: [0, 1, 2]

required:
  - compatible
  - reg
  - clocks

additionalProperties: false

examples:
  - |
    clocks {
        #address-cells = <1>;
        #size-cells = <0>;

        g762_clk: fixedclk {
                 compatible = "fixed-clock";
                 #clock-cells = <0>;
                 clock-frequency = <8192>;
        };
    };

    i2c {
        #address-cells = <1>;
        #size-cells = <0>;

        g762: g762@3e {
            compatible = "gmt,g762";
            reg = <0x3e>;
            clocks = <&g762_clk>;
            fan_gear_mode = <0>; /* chip default */
            fan_startv = <1>;    /* chip default */
            pwm_polarity = <0>;  /* chip default */
        };
    };
...
```

## Documentation/devicetree/bindings/input/gpio-beeper.yaml
```yaml
# SPDX-License-Identifier: (GPL-2.0 OR BSD-2-Clause)
%YAML 1.2
---
$id: http://devicetree.org/schemas/input/gpio-beeper.yaml#
$schema: http://devicetree.org/meta-schemas/core.yaml#

title: Beeper connected to a GPIO

maintainers:
  - Andrew Lunn <andrew@lunn.ch>

properties:
  compatible:
    const: gpio-beeper

  gpios:
    maxItems: 1

required:
  - compatible
  - gpios

additionalProperties: false

examples:
  - |
    #include <dt-bindings/gpio/gpio.h>

    beeper: beeper {
        compatible = "gpio-beeper";
        gpios = <&gpio3 23 GPIO_ACTIVE_HIGH>;
    };
...
```

## Documentation/devicetree/bindings/interrupt-controller/marvell,orion-bridge-intc.yaml
```yaml
# SPDX-License-Identifier: GPL-2.0-only
%YAML 1.2
---
$id: http://devicetree.org/schemas/interrupt-controller/marvell,orion-bridge-intc.yaml#
$schema: http://devicetree.org/meta-schemas/core.yaml#

title: Marvell Orion Bridge Interrupt controller bindings

maintainers:
  - Andrew Lunn <andrew@lunn.ch>
  - Gregory Clement <gregory.clement@bootlin.com>

properties:
  compatible:
    enum:
      - marvell,orion-bridge-intc

  reg:
    description:
      Base address of bridge interrupt registers starting with CAUSE register

  interrupts:
    description:
      bridge interrupt of the main interrupt controller

  interrupt-controller: true

  '#interrupt-cells':
    const: 1

  'marvell,#interrupts':
    description:
      number of interrupts provided by bridge interrupt controller
    $ref: /schemas/types.yaml#/definitions/uint32
    default: 32

required:
  - '#interrupt-cells'
  - compatible
  - reg
  - interrupt-controller

additionalProperties: false

examples:
  - |
    bridge_intc: interrupt-controller@20110 {
      compatible = "marvell,orion-bridge-intc";
      interrupt-controller;
      #interrupt-cells = <1>;
      reg = <0x20110 0x8>;
      interrupts = <0>;
      /* Dove bridge provides 5 interrupts */
      marvell,#interrupts = <5>;
    };

...
```

## Documentation/devicetree/bindings/leds/lacie,netxbig-leds.yaml
```yaml
# SPDX-License-Identifier: GPL-2.0-only OR BSD-2-Clause
%YAML 1.2
---
$id: http://devicetree.org/schemas/leds/lacie,netxbig-leds.yaml#
$schema: http://devicetree.org/meta-schemas/core.yaml#

title: CPLD LEDs (GPIO extension bus) found on some LaCie/Seagate

maintainers:
  - Andrew Lunn <andrew@lunn.ch>

properties:
  compatible:
    const: lacie,netxbig-leds

  gpio-ext:
    description:
      Phandle for the gpio-ext bus
    $ref: /schemas/types.yaml#/definitions/phandle

  timers:
    description:
      Timer array. Each timer entry is represented by three integers
      Mode (gpio-ext bus), delay_on and delay_off.
    $ref: /schemas/types.yaml#/definitions/uint32-array

patternProperties:
  "^.*-.*$":
    type: object
    $ref: common.yaml#

    properties:
      mode-addr:
        $ref: /schemas/types.yaml#/definitions/uint32-array
        description:
          Mode register address on gpio-ext bus.

      mode-val:
        $ref: /schemas/types.yaml#/definitions/uint32-array
        description:
          Mode to value mapping. Each entry is represented by two integers
          A mode and the corresponding value on the gpio-ext bus.

      bright-addr:
        $ref: /schemas/types.yaml#/definitions/uint32
        description:
          Brightness register address on gpio-ext bus.

      max-brightness:
        $ref: /schemas/types.yaml#/definitions/uint32

    additionalProperties: false

    required:
      - mode-addr
      - mode-val
      - bright-addr
      - max-brightness

additionalProperties: false

required:
  - compatible
  - gpio-ext

examples:
  - |
    #include <dt-bindings/gpio/gpio.h>
    #include <dt-bindings/leds/leds-netxbig.h>

    netxbig_gpio_ext: netxbig-gpio-ext {
        compatible = "lacie,netxbig-gpio-ext";

        addr-gpios = <&gpio1 15 GPIO_ACTIVE_HIGH
                      &gpio1 16 GPIO_ACTIVE_HIGH
                      &gpio1 17 GPIO_ACTIVE_HIGH>;
        data-gpios = <&gpio1 12 GPIO_ACTIVE_HIGH
                      &gpio1 13 GPIO_ACTIVE_HIGH
                      &gpio1 14 GPIO_ACTIVE_HIGH>;
        enable-gpio = <&gpio0 29 GPIO_ACTIVE_HIGH>;
    };

    netxbig-leds {
        compatible = "lacie,netxbig-leds";

        gpio-ext = <&netxbig_gpio_ext>;
        timers = <NETXBIG_LED_TIMER1 500 500
                  NETXBIG_LED_TIMER2 500 1000>;

        blue-power {
                label = "netxbig:blue:power";
                mode-addr = <0>;
                mode-val = <NETXBIG_LED_OFF 0
                            NETXBIG_LED_ON 1
                            NETXBIG_LED_TIMER1 3
                            NETXBIG_LED_TIMER2 7>;
                bright-addr = <1>;
                max-brightness = <7>;
        };
    };
...
```

## Documentation/devicetree/bindings/leds/lacie,ns2-leds.yaml
```yaml
# SPDX-License-Identifier: GPL-2.0-only OR BSD-2-Clause
%YAML 1.2
---
$id: http://devicetree.org/schemas/leds/lacie,ns2-leds.yaml#
$schema: http://devicetree.org/meta-schemas/core.yaml#

title: dual-GPIO LED found on Network Space v2 (and parents).

maintainers:
  - Andrew Lunn <andrew@lunn.ch>

properties:
  compatible:
    const: lacie,ns2-leds

patternProperties:
  "^.*-.*$":
    type: object
    $ref: common.yaml#

    properties:
      cmd-gpio:
        description:
          Command LED GPIO.
        maxItems: 1

      slow-gpio:
        description:
          Slow LED GPIO
        maxItems: 1

      modes-map:
        $ref: /schemas/types.yaml#/definitions/uint32-array
        description:
          A mapping between LED modes (off, on or SATA activity
          blinking) and the corresponding cmd-gpio/slow-gpio
          values. All the GPIO values combinations should be given
          in order to avoid having an unknown mode at driver probe
          time.

    required:
      - cmd-gpio
      - slow-gpio
      - modes-map

additionalProperties: false

required:
  - compatible

examples:
  - |
    #include <dt-bindings/leds/leds-ns2.h>

    ns2-leds {
        compatible = "lacie,ns2-leds";

        blue-sata {
            label = "ns2:blue:sata";
            slow-gpio = <&gpio0 29 0>;
            cmd-gpio = <&gpio0 30 0>;
            modes-map = <NS_V2_LED_OFF  0 1
                         NS_V2_LED_ON   1 0
                         NS_V2_LED_ON   0 0
                         NS_V2_LED_SATA 1 1>;
        };
    };
...
```

## Documentation/devicetree/bindings/mtd/marvell,orion-nand.yaml
```yaml
# SPDX-License-Identifier: (GPL-2.0-only OR BSD-2-Clause)
%YAML 1.2
---
$id: http://devicetree.org/schemas/mtd/marvell,orion-nand.yaml#
$schema: http://devicetree.org/meta-schemas/core.yaml#

title: Marvell Orion NAND Controller

allOf:
  - $ref: "nand-controller.yaml"

maintainers:
  - Andrew Lunn <andrew@lunn.ch>

properties:
  compatible:
    enum:
      - marvell,orion-nand

  "#address-cells":
    const: 1

  "#size-cells":
    const: 1

  reg:
    maxItems: 1

  interrupts:
    maxItems: 1

  clocks:
    maxItems: 1

  cle:
    description:
      Address line number connected to CLE. Default is 0
    $ref: /schemas/types.yaml#/definitions/uint32
    minimum: 0
    maximum: 255

  ale:
    description:
      Address line number connected to ALE. Default is 1
    $ref: /schemas/types.yaml#/definitions/uint32
    minimum: 0
    maximum: 255

  bank-width:
    description: Width (in bytes) of the bank.  Equal to the device width times
      the number of interleaved chips.
    $ref: /schemas/types.yaml#/definitions/uint32
    enum: [ 1, 2, 4 ]

  chip-delay:
    description:
      Chip dependent delay for transferring data from array to read
      registers in usecs
    $ref: /schemas/types.yaml#/definitions/uint32
    minimum: 0
    maximum: 255

  partitions:
    description:
      Deprecated container of partitions
    type: object

patternProperties:
  "@[0-9a-f]+$":
    $ref: "/schemas/mtd/partitions/partition.yaml"
    description:
      Partitions within the NAND

required:
  - compatible
  - reg

additionalProperties: false

examples:
  - |
    nand-controller@f4000000 {
        compatible = "marvell,orion-nand";
        #address-cells = <1>;
        #size-cells = <1>;
        cle = <0>;
        ale = <1>;
        bank-width = <1>;
        chip-delay = <25>;
        reg = <0xf4000000 0x400>;

        partition@0 {
            label = "u-boot";
            reg = <0x0000000 0x100000>;
            read-only;
        };
    };
...
```

## Documentation/devicetree/bindings/net/marvell,orion-eth.yaml
```yaml
# SPDX-License-Identifier: GPL-2.0
%YAML 1.2
---
$id: http://devicetree.org/schemas/net/marvell,orion-eth.yaml#
$schema: http://devicetree.org/meta-schemas/core.yaml#

title: Marvell Orion Controller

maintainers:
  - Andrew Lunn <andrew@lunn.ch>

description: |
  The Marvell Discovery ethernet controller can be found on Marvell
  Orion SoCs (Kirkwood, Dove, Orion5x, and Discovery Innovation) and
  as part of Marvell Discovery system controller chips (mv64[345]60).

  The Discovery ethernet controller is described with two levels of
  nodes. The first level describes the ethernet controller itself and
  the second level describes up to 3 ethernet port nodes within that
  controller. The reason for the multiple levels is that the port
  registers are interleaved within a single set of controller
  registers. Each port node describes port-specific properties.

  Note: The above separation is only true for Discovery system
  controllers.  For Orion SoCs we stick to the separation, although
  there each controller has only one port associated. Multiple ports
  are implemented as multiple single-port controllers. As Kirkwood has
  some issues with proper initialization after reset, an extra
  compatible string is added for it.

properties:
  compatible:
    enum:
      - marvell,orion-eth
      - marvell,kirkwood-eth

  reg:
    maxItems: 1
    description: The USB port number on the host controller

  "#address-cells":
    const: 1

  '#size-cells':
    const: 0

  clocks:
    maxItems: 1

  marvell,tx-checksum-limit:
    $ref: "/schemas/types.yaml#/definitions/uint32"
    description:
      max tx packet size for hardware checksum

patternProperties:
  "^ethernet[01]*-port@[0-9]$":
    type: object
    description: Ethernet port of controller

    $ref: ethernet-controller.yaml#

    properties:
      compatible:
        enum:
          - marvell,orion-eth-port
          - marvell,kirkwood-eth-port

      reg:
        description: port number relative to ethernet controller
        items:
          - enum: [0, 2]

      interrupts:
        maxItems: 1

      marvell,tx-queue-size:
        description:
          size of the transmit ring buffer.
        $ref: "/schemas/types.yaml#/definitions/uint32"

      marvell,tx-sram-addr:
        description:
          address of transmit descriptor buffer located in SRAM.
        $ref: "/schemas/types.yaml#/definitions/uint32"

      marvell,tx-sram-size:
        description:
          size of transmit descriptor buffer located in SRAM.
        $ref: "/schemas/types.yaml#/definitions/uint32"

      marvell,rx-queue-size:
        description:
          size of the receive ring buffer.
        $ref: "/schemas/types.yaml#/definitions/uint32"

      marvell,rx-sram-addr:
        description:
          address of receive descriptor buffer located in SRAM.
        $ref: "/schemas/types.yaml#/definitions/uint32"

      marvell,rx-sram-size:
        description:
          size of receive descriptor buffer located in SRAM.
        $ref: "/schemas/types.yaml#/definitions/uint32"

      speed:
        description: port speed if no PHY connected
        $ref: "/schemas/types.yaml#/definitions/uint32"
        enum: [10, 100, 1000]

      duplex:
        description: port mode if no PHY connected
        $ref: "/schemas/types.yaml#/definitions/uint32"
        enum: [0, 1]

    required:
      - compatible
      - reg
      - interrupts

    unevaluatedProperties: false

required:
  - compatible
  - reg
  - "#address-cells"
  - "#size-cells"

unevaluatedProperties: false

examples:
  - |
    eth: ethernet-controller@72000 {
        compatible = "marvell,orion-eth";
        #address-cells = <1>;
        #size-cells = <0>;
        reg = <0x72000 0x2000>;
        clocks = <&gate_clk 2>;
        marvell,tx-checksum-limit = <1600>;

        ethernet-port@0 {
                compatible = "marvell,orion-eth-port";
                reg = <0>;
                interrupts = <29>;
                phy-handle = <&ethphy>;
                local-mac-address = [00 00 00 00 00 00];
        };
    };
...
```

## Documentation/devicetree/bindings/phy/marvell,mvebu-sata-phy.yaml
```yaml
# SPDX-License-Identifier: (GPL-2.0-or-later OR BSD-2-Clause)
%YAML 1.2
---
$id: http://devicetree.org/schemas/phy/marvell,mvebu-sata-phy.yaml#
$schema: http://devicetree.org/meta-schemas/core.yaml#

title: Marvell Orion SATA PHY

maintainers:
  - Andrew Lunn <andrew@lunn.ch>

properties:
  $nodename:
    pattern: '^sata-phy@[a-f0-9]+$'

  compatible:
    const: marvell,mvebu-sata-phy

  reg:
    maxItems: 1
    description: base address of the device

  '#phy-cells':
    const: 0

  clocks:
    maxItems: 1

  clock-names:
    maxItems: 1

required:
  - compatible
  - reg
  - '#phy-cells'
  - clocks
  - clock-names

additionalProperties: false

examples:
  - |
    sata_phy0: sata-phy@82000 {
        compatible = "marvell,mvebu-sata-phy";
        reg = <0x82000 0x0334>;
        clocks = <&gate_clk 14>;
        clock-names = "sata";
        #phy-cells = <0>;
    };

...
```
